## Documentation/devicetree/bindings/display/panel/jdi,lt070me05000.txt
```
JDI model LT070ME05000 1200x1920 7" DSI Panel

Required properties:
- compatible: should be "jdi,lt070me05000"
- vddp-supply: phandle of the regulator that provides the supply voltage
  Power IC supply (3-5V)
- dcdc_en-supply: phandle of the regulator that provides the supply voltage
  Power IC supply enable, High active
- vcc-supply: phandle of the regulator that provides the supply voltage
  IOVCC , power supply for LCM (1.8V)
- reset-gpios: phandle of gpio for reset line
  This should be 8mA, gpio can be configured using mux, pinctrl, pinctrl-names
  XRES, Reset, Low active
- enable-gpios: phandle of gpio for enable line
  LED_EN, LED backlight enable, High active

Example:

	vcc_1p8v: regulator-fixed@2 {
		compatible = "regulator-fixed";
		regulator-min-microvolt = <1800000>;
		regulator-max-microvolt = <1800000>;
		regulator-name = "vcc_1p8v";
		regulator-type = "voltage";
		startup-delay-us = <0>;
		gpio = <&pm8921_gpio 23 GPIO_ACTIVE_HIGH>;
		enable-active-high;
		regulator-boot-on;
	};

	tlmm_pinmux: pinctrl@800000 {

		dsi_panel_pinctrl: dsi-panel-pinctrl {
			mux {
				pins = "gpio54";
				function = "gpio";
				bias-pull-up;
				drive-strength = <8>;
			};
		};
	};

	dsi0: qcom,mdss_dsi@4700000 {
		panel@0 {
			compatible = "jdi,lt070me05000";
			reg = <0>;
			pinctrl-names = "default";
			pinctrl-0 = <&dsi_panel_pinctrl>;

			vddp-supply = <&pm8921_l17>;
			dcdc_en-supply = <&pm8921_lvs7>;
			vcc-supply = <&vcc_1p8v>;

			reset-gpios = <&tlmm_pinmux 54 0>;
			enable-gpios = <&pm8921_gpio 36 GPIO_ACTIVE_HIGH>;
		};
	};
```

## Documentation/devicetree/bindings/power/reset/reboot-mode.txt
```
Generic reboot mode core map driver

This driver get reboot mode arguments and call the write
interface to stores the magic value in special register
or ram . Then the bootloader can read it and take different
action according to the argument stored.

Required properties:
- compatible: only support "syscon-reboot-mode" now.

Each mode is represented as a sub-node of reboot_mode:

Subnode required properties:
- linux,mode: reboot mode command,such as "loader", "recovery", "fastboot".
- loader,magic: magic number for the mode, this is vendor specific.

Example:
	reboot_mode {
		compatible = "syscon-reboot-mode";
		offset = <0x40>;

		loader {
			linux,mode = "loader";
			loader,magic = <BOOT_LOADER>;
		};

		maskrom {
			linux,mode = "maskrom";
			loader,magic = <BOOT_MASKROM>;
		};

		recovery {
			linux,mode = "recovery";
			loader,magic = <BOOT_RECOVERY>;
		};

		fastboot {
			linux,mode = "fastboot";
			loader,magic = <BOOT_FASTBOOT>;
		};
        };
```

## Documentation/devicetree/bindings/power/reset/syscon-reboot-mode.txt
```
SYSCON reboot mode driver

This driver get reboot mode magic value form reboot-mode driver
and stores it in a SYSCON mapped register. Then the bootloader
can read it and take different action according to the magic
value stored.

This DT node should be represented as a sub-node of a "syscon", "simple-mfd"
node.

Required properties:
- compatible: should be "syscon-reboot-mode"
- offset: offset in the register map for the storage register (in bytes)

The rest of the properties should follow the generic reboot-mode discription
found in reboot-mode.txt

Example:
	pmu: pmu@20004000 {
		compatible = "rockchip,rk3066-pmu", "syscon", "simple-mfd";
		reg = <0x20004000 0x100>;

		reboot-mode {
			compatible = "syscon-reboot-mode";
			offset = <0x40>;

			normal {
				linux,mode = "normal";
				loader,magic = <BOOT_NORMAL>;
			};

			loader {
				linux,mode = "loader";
				loader,magic = <BOOT_LOADER>;
			};

			maskrom {
				linux,mode = "maskrom";
				loader,magic = <BOOT_MASKROM>;
			};

			recovery {
				linux,mode = "recovery";
				loader,magic = <BOOT_RECOVERY>;
			};

			fastboot {
				linux,mode = "fastboot";
				loader,magic = <BOOT_FASTBOOT>;
			};
		};
	};
```

## Documentation/devicetree/bindings/soc/qcom/qcom,wcnss.txt
```
Qualcomm WCNSS Binding

This binding describes the Qualcomm WCNSS hardware. It consists of control
block and a BT, WiFi and FM radio block, all useing SMD as command channels.

- compatible:
	Usage: required
	Value type: <string>
	Definition: must be: "qcom,wcnss",

- qcom,smd-channel:
	Usage: required
	Value type: <string>
	Definition: standard SMD property specifying the SMD channel used for
		    communication with the WiFi firmware

= SUBNODES
The subnodes of the wcnss node are optional and describe the individual blocks in
the WCNSS.

== Bluetooth
The following properties are defined to the bluetooth node:

- compatible:
	Usage: required
	Value type: <string>
	Definition: must be: "qcom,btqcomsmd"

== WiFi
The following properties are defined to the WiFi node:

- compatible:
	Usage: required
	Value type: <string>
	Definition: must be one of:
		    "qcom,wcn3620-wlan",
		    "qcom,wcn3660-wlan",
		    "qcom,wcn3680-wlan"

- qcom,wcnss-mmio:
	Usage: required
	Value type: <prop-encoded-array>
	Definition: should specify base address and size of the WiFi related
		    registers of WCNSS

- interrupts:
	Usage: required
	Value type: <prop-encoded-array>
	Definition: should specify the "rx" and "tx" interrupts

- interrupt-names:
	Usage: required
	Value type: <stringlist>
	Definition: must contain "rx" and "tx"

- qcom,state:
	Usage: required
	Value type: <prop-encoded-array>
	Definition: should reference the tx-enable and tx-rings-empty SMEM states

- qcom,state-names:
	Usage: required
	Value type: <stringlist>
	Definition: must contain "tx-enable" and "tx-rings-empty"

= EXAMPLE
The following example represents a SMD node, with one edge representing the
"pronto" subsystem, with the wcnss device and its wcn3680 BT and WiFi blocks
described; as found on the 8974 platform.

smd {
	compatible = "qcom,smd";

	pronto {
		interrupts = <0 142 1>;

		qcom,ipc = <&apcs 8 17>;
		qcom,smd-edge = <6>;

		wcnss {
			compatible = "qcom,wcnss";
			qcom,smd-channels = "WCNSS_CTRL";

			#address-cells = <1>;
			#size-cells = <1>;

			bt {
				compatible = "qcom,btqcomsmd";
			};

			wifi {
				compatible = "qcom,wcn3680-wlan";

				qcom,wcnss-mmio = <0xfb000000 0x21b000>;

				interrupts = <0 145 0>, <0 146 0>;
				interrupt-names = "tx", "rx";

				qcom,state = <&apps_smsm 10>, <&apps_smsm 9>;
				qcom,state-names = "tx-enable", "tx-rings-empty";
			};
		};
	};
};
```
